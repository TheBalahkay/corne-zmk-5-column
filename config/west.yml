## config/west.yml
```yaml
manifest:
  remotes:
    - name: zmkfirmware
      url-base: https://github.com/ftc/
  projects:
    - name: zmk
      remote: zmkfirmware
      revision: https://github.com/ftc/
      import: app/west.yml
  self:
    path: config
```
